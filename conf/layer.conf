## conf/layer.conf
```bitbake
# We have a conf and classes directory, append to BBPATH
BBPATH .= ":${LAYERDIR}"

# We have a recipes directory containing .bb and .bbappend files, add to BBFILES
BBFILES += "${LAYERDIR}/recipes*/*/*.bb \
            ${LAYERDIR}/recipes*/*/*.bbappend"

BBFILE_COLLECTIONS += "pru"
BBFILE_PATTERN_pru := "^${LAYERDIR}/"
BBFILE_PRIORITY_pru = "6"

LAYERDEPENDS_pru = "meta-ti"
```
